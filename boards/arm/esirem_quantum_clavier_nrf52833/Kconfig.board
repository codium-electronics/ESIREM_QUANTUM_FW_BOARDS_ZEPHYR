## boards/arm/esirem_quantum_clavier_nrf52833/Kconfig.board
```kconfig
# ESIREM main NRF52833 board configuration

# Copyright (c) 2019 Nordic Semiconductor ASA
# SPDX-License-Identifier: Apache-2.0

config BOARD_ESIREM_QUANTUM_CLAVIER_NRF52833
	bool "ESIREM Quantum Clavier nRF52833"
	depends on SOC_NRF52833_QIAA
```

## boards/arm/esirem_quantum_clavier_nrf52833/Kconfig.defconfig
```kconfig
# ESIREM quantum clavier nRF52833 board configuration

# Copyright (c) 2019 Nordic Semiconductor ASA
# SPDX-License-Identifier: Apache-2.0

if BOARD_ESIREM_QUANTUM_CLAVIER_NRF52833

config BOARD
	default "esirem_quantum_clavier_nrf52833"

if USB

config USB_NRFX
	default y

config USB_DEVICE_STACK
	default y

endif # USB

config BT_CTLR
	default BT

endif # BOARD_ESIREM_QUANTUM_CLAVIER_NRF52833
```

## boards/arm/esirem_quantum_clavier_nrf52833/esirem_quantum_clavier_nrf52833_defconfig
```kconfig
# SPDX-License-Identifier: Apache-2.0

CONFIG_SOC_SERIES_NRF52X=y
CONFIG_SOC_NRF52833_QIAA=y
CONFIG_BOARD_ESIREM_QUANTUM_CLAVIER_NRF52833=y

# Enable MPU
CONFIG_ARM_MPU=y

# Enable the UART driver
CONFIG_SERIAL=y

# enable GPIO
CONFIG_GPIO=y

# disable console (no UART left, one for the PIC, one for the fibocomi LTE modem)
CONFIG_CONSOLE=y
CONFIG_UART_CONSOLE=n

# additional board options
CONFIG_GPIO_AS_PINRESET=y
```

## boards/arm/esirem_quantum_main_nrf52833/Kconfig
```kconfig
# ESIREM main NRF52833 board configuration

# Copyright (c) 2019 Nordic Semiconductor ASA
# SPDX-License-Identifier: Apache-2.0

config BOARD_ENABLE_DCDC
	bool "Enable DCDC mode"
	select SOC_DCDC_NRF52X
	default y
	depends on BOARD_ESIREM_QUANTUM_MAIN_NRF52833
```

## boards/arm/esirem_quantum_main_nrf52833/Kconfig.board
```kconfig
# ESIREM main NRF52833 board configuration

# Copyright (c) 2019 Nordic Semiconductor ASA
# SPDX-License-Identifier: Apache-2.0

config BOARD_ESIREM_QUANTUM_MAIN_NRF52833
	bool "ESIREM quantum main nRF52833"
	depends on SOC_NRF52833_QIAA
```

## boards/arm/esirem_quantum_main_nrf52833/Kconfig.defconfig
```kconfig
# ESIREM main nRF52833 board configuration

# Copyright (c) 2019 Nordic Semiconductor ASA
# SPDX-License-Identifier: Apache-2.0

if BOARD_ESIREM_QUANTUM_MAIN_NRF52833

config BOARD
	default "esirem_quantum_main_nrf52833"

if USB

config USB_NRFX
	default y

config USB_DEVICE_STACK
	default y

endif # USB

config BT_CTLR
	default BT

endif # BOARD_ESIREM_QUANTUM_MAIN_NRF52833
```
